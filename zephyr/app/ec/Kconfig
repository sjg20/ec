## zephyr/app/ec/Kconfig
```kconfig
# Copyright 2020 The Chromium OS Authors. All rights reserved.
# Use of this source code is governed by a BSD-style license that can be
# found in the LICENSE file.

menuconfig CROS_EC
	bool "Chrome EC"
	imply SHELL
	imply PRINTK
	help
	  Utilize the common Chrome EC application

if CROS_EC

choice
	prompt "ChromeOS EC firmware section"

config CROS_EC_RO
	bool "This build is will be for the RO copy of the EC"
	help
	  This build will be used to produce a copy for the read-only
	  section of the EC firmware.

config CROS_EC_RW
	bool "This build is will be for the RW copy of the EC"
	help
	  This build will be used to produce a copy for the read-write
	  section of the EC firmware.

endchoice

config CROS_EC_ACTIVE_COPY
	string
	default "RO" if CROS_EC_RO
	default "RW" if CROS_EC_RW
	help
	  When the active copy name is output to a console, this
	  string will be displayed.

endif # CROS_EC
```

## zephyr/projects/experimental/scarlet/boards/arm/scarlet/Kconfig.board
```kconfig
# Google Scarlet EC

# Copyright 2020 The Chromium OS Authors
# SPDX-License-Identifier: Apache-2.0

config BOARD_SCARLET
	bool "Google Scarlet EC"
	depends on SOC_STM32F098XX
```

## zephyr/projects/experimental/scarlet/boards/arm/scarlet/Kconfig.defconfig
```kconfig
# Google Scarlet EC

# Copyright 2020 The Chromium OS Authors
# SPDX-License-Identifier: Apache-2.0

if BOARD_SCARLET

config BOARD
	default "scarlet"

endif # BOARD_SCARLET
```
