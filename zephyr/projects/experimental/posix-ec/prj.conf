## CMakeLists.txt
```
# Copyright 2020 The Chromium OS Authors. All rights reserved.
# Use of this source code is governed by a BSD-style license that can be
# found in the LICENSE file.
# SPDX-License-Identifier: Apache-2.0

cmake_minimum_required(VERSION 3.13.1)
set(BOARD native_posix)

find_package(Zephyr REQUIRED HINTS $ENV{ZEPHYR_BASE})
project(posix-ec)

target_sources(app PRIVATE src/main.c)
```

## prj.conf
```kconfig
CONFIG_CROS_EC=y
CONFIG_PLATFORM_EC=y

# Disable shimmed code. Can enabled selectively later
CONFIG_SHIMMED_TASKS=n
CONFIG_PLATFORM_EC_KEYBOARD=n
CONFIG_PLATFORM_EC_HOSTCMD=n
CONFIG_PLATFORM_EC_I2C=n
CONFIG_PLATFORM_EC_TIMER=n

# Define necessary program memory locations. These are meaning less though
CONFIG_CROS_EC_PROGRAM_MEMORY_BASE=0x10090000
CONFIG_CROS_EC_RAM_BASE=0x200c0000
CONFIG_CROS_EC_DATA_RAM_SIZE=0x00010000
CONFIG_CROS_EC_RAM_SIZE=0x0000f800
CONFIG_CROS_EC_RO_MEM_OFF=0x0
CONFIG_CROS_EC_RO_SIZE=0xb000
CONFIG_CROS_EC_RW_MEM_OFF=0xb000
CONFIG_CROS_EC_RW_SIZE=0x75000
```

## src/main.c
```c
/* Copyright 2020 The Chromium OS Authors. All rights reserved.
 * Use of this source code is governed by a BSD-style license that can be
 * found in the LICENSE file.
 */

#include <zephyr.h>

void main(void)
{
}
```
